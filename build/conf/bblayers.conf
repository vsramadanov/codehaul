## build/conf/bblayers.conf
```bitbake
# POKY_BBLAYERS_CONF_VERSION is increased each time build/conf/bblayers.conf
# changes incompatibly
POKY_BBLAYERS_CONF_VERSION = "2"

BBPATH = "${TOPDIR}"
BBFILES ?= ""

BBLAYERS ?= " \
  /home/fkeel/sandbox/yocto/codehaul/poky/meta \
  /home/fkeel/sandbox/yocto/codehaul/poky/meta-poky \
  /home/fkeel/sandbox/yocto/codehaul/poky/meta-yocto-bsp \
  /home/fkeel/sandbox/yocto/codehaul/meta-raspberrypi \
  /home/fkeel/sandbox/yocto/codehaul/meta-codehaul \
  "
```

## build/conf/local.conf
```bitbake
MACHINE = "raspberrypi3-64"

DISTRO ?= "poky"

PACKAGE_CLASSES = "package_rpm"

EXTRA_IMAGE_FEATURES ?= "\
    allow-empty-password \
    empty-root-password  \
    allow-root-login"
USER_CLASSES ?= "buildstats"
PATCHRESOLVE = "noop"
BB_DISKMON_DIRS ??= "\
    STOPTASKS,${TMPDIR},1G,100K \
    STOPTASKS,${DL_DIR},1G,100K \
    STOPTASKS,${SSTATE_DIR},1G,100K \
    STOPTASKS,/tmp,100M,100K \
    HALT,${TMPDIR},100M,1K \
    HALT,${DL_DIR},100M,1K \
    HALT,${SSTATE_DIR},100M,1K \
    HALT,/tmp,10M,1K"

PACKAGECONFIG:append:pn-qemu-system-native = " sdl"

RPI_USE_U_BOOT = "1"
ENABLE_UART    = "1"
DISABLE_RPI_BOOT_LOGO = "0"

EXTRA_IMAGE_FEATURES ?= "debug-tweaks ssh-server-openssh"
MACHINE_FEATURES:append = " bluetooth"
DISTRO_FEATURES:append = " systemd usrmerge"
DISTRO_FEATURES_BACKFILL_CONSIDERED:append = "sysvinit"
VIRTUAL-RUNTIME_init_manager = "systemd"
VIRTUAL-RUNTIME_initscripts = "systemd-compat-units"

CONF_VERSION = "2"

LICENSE_FLAGS_ACCEPTED="synaptics-killswitch"
```

## meta-codehaul/conf/layer.conf
```bitbake
BBPATH  .= ":${LAYERDIR}"
BBFILES += "${LAYERDIR}/recipes*/*/*.bb \ 
            ${LAYERDIR}/recipes*/*/*.bbappend"
BBFILE_COLLECTIONS += "codehaul"
BBFILE_PATTERN_codehaul := "^${LAYERDIR}/"

BBFILE_PRIORITY_codehaul = "9"

LAYERSERIES_COMPAT_codehaul = "scarthgap"
```
